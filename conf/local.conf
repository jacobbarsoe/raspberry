## conf/local.conf
```bitbake
#MACHINE = "gallega-mk3"
DISTRO = "basic"

PROVIDED = "all"

TARGET_CPU	= "powerpc"
TARGET_VENDOR	= ""
TARGET_OS	= "linux"

SDK_CPU		= "i486"
SDK_VENDOR	= ""
SDK_OS		= "mingw32"
```

## conf/local.conf.sample
```bitbake
DISTRO		?= "base"

# Use one of these for selecting machine architecture
#MACHINE	?= "mpc8313erdb"
#MACHINE_CPU	 = "powerpc-mpc8313"
MACHINE_CPU	 = "arm-at91rm9200"

PROVIDED	 = "all"

# MinGW32 SDK
SDK_CPU		 = "i586"
SDK_OS		 = "mingw32"

# 32-bit Linux SDK
#SDK_CPU	 = "i586"
#SDK_OS		 = "linux-gnu"

# 64-bit Linux SDK
#SDK_CPU	 = "x86_64"
#SDK_OS		 = "linux-gnu"
```
